## package/Config.in
```kconfig
menu "Motion Logger"
source "$BR2_EXTERNAL_MOTION_LOGGER_PATH/package/motion_logger/Config.in"
endmenu
```

## package/motion_logger/Config.in
```kconfig
config BR2_PACKAGE_MOTION_LOGGER
	bool "motion_logger"
	select BR2_PACKAGE_LIBGPIOD
	help
	  Motion logger for Raspberry Pi 5: reads accelerometers and GPS,
	  detects movement and writes a log (Ajax Embedded Linux Internship).
```
